/*@!Encoding:1250*/
includes
{
  
}

variables
{
  double counter = 0.0;
  msTimer mainTimer;
}

on start
{
  SetTimer(mainTimer, 1);
}

on timer mainTimer
{
  $ExampleData::Counter = sin(counter);
  putValue(var, sin(counter));
  
  counter += 0.01;
  SetTimer(mainTimer, 1);
  
  
}

on envVar var
{
  Write("value cahnged");
}