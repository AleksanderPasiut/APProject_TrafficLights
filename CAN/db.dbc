VERSION ""

NS_ :

BS_:

BU_: master_node ECU1

BO_ 77 ExampleData: 8 ECU1
 SG_ Counter : 0|64@1- (1,0) [0|0] "" Vector__XXX

EV_ var: 1 [0|0] "" 0 1 DUMMY_NODE_VECTOR3 Vector__XXX;

SIG_VALTYPE_ 77 Counter : 2;
