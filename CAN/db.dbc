VERSION ""

NS_ :

BS_:

BU_: master_node ECU1

BO_ 77 ExampleData: 8 ECU1
 SG_ Counter : 0|64@1- (1,0) [0|0] "" Vector__XXX

SIG_VALTYPE_ 77 Counter : 2;
