VERSION ""

NS_ :

BS_:

BU_: slave master

BO_ 3221225472 VECTOR__INDEPENDENT_SIG_MSG: 0 Vector__XXX
 SG_ output18 : 0|1@1+ (1,0) [0|1] "" Vector__XXX

BO_ 0 TrafficLightsControl: 8 slave
 SG_ output17 : 37|1@1+ (1,0) [0|1] "" Vector__XXX
 SG_ output16 : 36|1@1+ (1,0) [0|1] "" Vector__XXX
 SG_ output15 : 35|1@1+ (1,0) [0|1] "" Vector__XXX
 SG_ output14 : 34|1@1+ (1,0) [0|1] "" Vector__XXX
 SG_ output13 : 33|1@1+ (1,0) [0|1] "" Vector__XXX
 SG_ output9_yellow : 29|1@1+ (1,0) [0|1] "" Vector__XXX
 SG_ output9_green : 27|1@1+ (1,0) [0|1] "" Vector__XXX
 SG_ output8_green : 24|1@1+ (1,0) [0|1] "" Vector__XXX
 SG_ output8_yellow : 26|1@1+ (1,0) [0|1] "" Vector__XXX
 SG_ output7_yellow : 23|1@1+ (1,0) [0|1] "" Vector__XXX
 SG_ output7_green : 21|1@1+ (1,0) [0|1] "" Vector__XXX
 SG_ output6_yellow : 20|1@1+ (1,0) [0|1] "" Vector__XXX
 SG_ output6_green : 18|1@1+ (1,0) [0|1] "" Vector__XXX
 SG_ output5_green : 15|1@1+ (1,0) [0|1] "" Vector__XXX
 SG_ output5_yellow : 17|1@1+ (1,0) [0|1] "" Vector__XXX
 SG_ output4_yellow : 14|1@1+ (1,0) [0|1] "" Vector__XXX
 SG_ output3_yellow : 11|1@1+ (1,0) [0|1] "" Vector__XXX
 SG_ output4_green : 12|1@1+ (1,0) [0|1] "" Vector__XXX
 SG_ output3_green : 9|1@1+ (1,0) [0|1] "" Vector__XXX
 SG_ output2_yellow : 8|1@1+ (1,0) [0|1] "" Vector__XXX
 SG_ output2_green : 6|1@1+ (1,0) [0|1] "" Vector__XXX
 SG_ output1_yellow : 5|1@1+ (1,0) [0|1] "" Vector__XXX
 SG_ output1_green : 3|1@1+ (1,0) [0|1] "" Vector__XXX
 SG_ output0_yellow : 2|1@1+ (1,0) [0|1] "" Vector__XXX
 SG_ output0_green : 0|1@1+ (1,0) [0|1] "" Vector__XXX
 SG_ output12 : 32|1@1+ (1,0) [0|1] "" Vector__XXX
 SG_ output11 : 31|1@1+ (1,0) [0|1] "" Vector__XXX
 SG_ output10 : 30|1@1+ (1,0) [0|1] "" Vector__XXX
 SG_ output7_red : 22|1@1+ (1,0) [0|1] "" Vector__XXX
 SG_ output9_red : 28|1@1+ (1,0) [0|1] "" Vector__XXX
 SG_ output8_red : 25|1@1+ (1,0) [0|1] "" Vector__XXX
 SG_ output6_red : 19|1@1+ (1,0) [0|1] "" Vector__XXX
 SG_ output5_red : 16|1@1+ (1,0) [0|1] "" Vector__XXX
 SG_ output4_red : 13|1@1+ (1,0) [0|1] "" Vector__XXX
 SG_ output3_red : 10|1@1+ (1,0) [0|1] "" Vector__XXX
 SG_ output2_red : 7|1@1+ (1,0) [0|1] "" Vector__XXX
 SG_ output1_red : 4|1@1+ (1,0) [0|1] "" Vector__XXX
 SG_ output0_red : 1|1@1+ (1,0) [0|1] "" Vector__XXX

BO_ 77 CyclePhase: 8 master
 SG_ input9 : 17|1@1+ (1,0) [0|1] "" Vector__XXX
 SG_ input8 : 16|1@1+ (1,0) [0|1] "" Vector__XXX
 SG_ input7 : 15|1@1+ (1,0) [0|1] "" Vector__XXX
 SG_ input6 : 14|1@1+ (1,0) [0|1] "" Vector__XXX
 SG_ input5 : 13|1@1+ (1,0) [0|1] "" Vector__XXX
 SG_ input4 : 12|1@1+ (1,0) [0|1] "" Vector__XXX
 SG_ input3 : 11|1@1+ (1,0) [0|1] "" Vector__XXX
 SG_ input2 : 10|1@1+ (1,0) [0|1] "" Vector__XXX
 SG_ input17 : 9|1@1+ (1,0) [0|1] "" Vector__XXX
 SG_ input16 : 8|1@1+ (1,0) [0|1] "" Vector__XXX
 SG_ input15 : 7|1@1+ (1,0) [0|1] "" Vector__XXX
 SG_ input14 : 6|1@1+ (1,0) [0|1] "" Vector__XXX
 SG_ input13 : 5|1@1+ (1,0) [0|1] "" Vector__XXX
 SG_ input12 : 4|1@1+ (1,0) [0|1] "" Vector__XXX
 SG_ input11 : 3|1@1+ (1,0) [0|1] "" Vector__XXX
 SG_ input10 : 2|1@1+ (1,0) [0|1] "" Vector__XXX
 SG_ input1 : 1|1@1+ (1,0) [0|1] "" Vector__XXX
 SG_ time : 32|32@1- (1,0) [0|0] "" Vector__XXX
 SG_ input0 : 0|1@1+ (1,0) [0|1] "" Vector__XXX

EV_ Tcycle: 1 [0|0] "" 60 1 DUMMY_NODE_VECTOR3 Vector__XXX;

EV_ Frequency17: 0 [0|0] "" 0 2 DUMMY_NODE_VECTOR3  master;

EV_ Frequency16: 0 [0|0] "" 0 3 DUMMY_NODE_VECTOR3  master;

EV_ Frequency15: 0 [0|0] "" 0 4 DUMMY_NODE_VECTOR3  master;

EV_ Frequency14: 0 [0|0] "" 0 5 DUMMY_NODE_VECTOR3  master;

EV_ Frequency13: 0 [0|0] "" 0 6 DUMMY_NODE_VECTOR3  master;

EV_ Frequency12: 0 [0|0] "" 0 7 DUMMY_NODE_VECTOR3  master;

EV_ Frequency11: 0 [0|0] "" 0 8 DUMMY_NODE_VECTOR3  master;

EV_ Frequency10: 0 [0|0] "" 0 9 DUMMY_NODE_VECTOR3  master;

EV_ Frequency9: 0 [0|0] "" 0 10 DUMMY_NODE_VECTOR3  master;

EV_ Frequency8: 0 [0|0] "" 0 11 DUMMY_NODE_VECTOR3  master;

EV_ Frequency7: 0 [0|0] "" 0 12 DUMMY_NODE_VECTOR3  master;

EV_ Frequency6: 0 [0|0] "" 0 13 DUMMY_NODE_VECTOR3  master;

EV_ Frequency5: 0 [0|0] "" 0 14 DUMMY_NODE_VECTOR3  master;

EV_ Frequency4: 0 [0|0] "" 0 15 DUMMY_NODE_VECTOR3  master;

EV_ Frequency3: 0 [0|0] "" 0 16 DUMMY_NODE_VECTOR3  master;

EV_ Frequency2: 0 [0|0] "" 0 17 DUMMY_NODE_VECTOR3  master;

EV_ Frequency1: 0 [0|0] "" 0 18 DUMMY_NODE_VECTOR3  master;

EV_ Frequency0: 0 [0|0] "" 0 19 DUMMY_NODE_VECTOR3  master;

EV_ Check_Input0: 0 [0|0] "" 1 20 DUMMY_NODE_VECTOR3  master;

EV_ Check_Input10: 0 [0|0] "" 1 21 DUMMY_NODE_VECTOR3  master;

EV_ Check_Input11: 0 [0|0] "" 1 22 DUMMY_NODE_VECTOR3  master;

EV_ Check_Input12: 0 [0|0] "" 1 23 DUMMY_NODE_VECTOR3  master;

EV_ Check_Input13: 0 [0|0] "" 1 24 DUMMY_NODE_VECTOR3  master;

EV_ Check_Input14: 0 [0|0] "" 1 25 DUMMY_NODE_VECTOR3  master;

EV_ Check_Input15: 0 [0|0] "" 1 26 DUMMY_NODE_VECTOR3  master;

EV_ Check_Input16: 0 [0|0] "" 1 27 DUMMY_NODE_VECTOR3  master;

EV_ Check_Input5: 0 [0|0] "" 1 28 DUMMY_NODE_VECTOR3  master;

EV_ Check_Input6: 0 [0|0] "" 1 29 DUMMY_NODE_VECTOR3  master;

EV_ Check_Input7: 0 [0|0] "" 1 30 DUMMY_NODE_VECTOR3  master;

EV_ Check_Input8: 0 [0|0] "" 1 31 DUMMY_NODE_VECTOR3  master;

EV_ Check_Input9: 0 [0|0] "" 1 32 DUMMY_NODE_VECTOR3  master;

EV_ Check_Input4: 0 [0|0] "" 1 33 DUMMY_NODE_VECTOR3  master;

EV_ Check_Input3: 0 [0|0] "" 1 34 DUMMY_NODE_VECTOR3  master;

EV_ Check_Input2: 0 [0|0] "" 1 35 DUMMY_NODE_VECTOR3  master;

EV_ Check_Input1: 0 [0|0] "" 1 36 DUMMY_NODE_VECTOR3  master;

EV_ Check_Input17: 0 [0|0] "" 1 37 DUMMY_NODE_VECTOR3  master;

EV_ Check_Output0: 0 [0|0] "" 0 38 DUMMY_NODE_VECTOR3  master;

EV_ Check_Output3: 0 [0|0] "" 0 39 DUMMY_NODE_VECTOR3  master;

EV_ Check_Output2: 0 [0|0] "" 0 40 DUMMY_NODE_VECTOR3  master;

EV_ Check_Output1: 0 [0|0] "" 0 41 DUMMY_NODE_VECTOR3  master;

EV_ Tyellow: 1 [0|0] "" 4 42 DUMMY_NODE_VECTOR3 Vector__XXX;

EV_ Tmax: 1 [0|0] "" 35 43 DUMMY_NODE_VECTOR3 Vector__XXX;

EV_ Tmin: 1 [0|0] "" 9 44 DUMMY_NODE_VECTOR3 Vector__XXX;

CM_ BO_ 3221225472 "This is a message for not used signals, created by Vector CANdb++ DBC OLE DB Provider.";
CM_ SG_ 77 time "Okreœla czas trwania danej fazy.";
CM_ EV_ Tcycle "Ca³kowity czas cyklu.";
CM_ EV_ Frequency17 "Czujnik natê¿enia ruchu na wlocie";
CM_ EV_ Frequency16 "Czujnik natê¿enia ruchu na wlocie";
CM_ EV_ Frequency15 "Czujnik natê¿enia ruchu na wlocie";
CM_ EV_ Frequency14 "Czujnik natê¿enia ruchu na wlocie";
CM_ EV_ Frequency13 "Czujnik natê¿enia ruchu na wlocie";
CM_ EV_ Frequency12 "Czujnik natê¿enia ruchu na wlocie";
CM_ EV_ Frequency11 "Czujnik natê¿enia ruchu na wlocie";
CM_ EV_ Frequency10 "Czujnik natê¿enia ruchu na wlocie";
CM_ EV_ Frequency9 "Czujnik natê¿enia ruchu na wlocie";
CM_ EV_ Frequency8 "Czujnik natê¿enia ruchu na wlocie";
CM_ EV_ Frequency7 "Czujnik natê¿enia ruchu na wlocie";
CM_ EV_ Frequency6 "Czujnik natê¿enia ruchu na wlocie";
CM_ EV_ Frequency5 "Czujnik natê¿enia ruchu na wlocie";
CM_ EV_ Frequency4 "Czujnik natê¿enia ruchu na wlocie";
CM_ EV_ Frequency3 "Czujnik natê¿enia ruchu na wlocie";
CM_ EV_ Frequency2 "Czujnik natê¿enia ruchu na wlocie";
CM_ EV_ Frequency1 "Czujnik natê¿enia ruchu na wlocie";
CM_ EV_ Frequency0 "Czujnik natê¿enia ruchu na wlocie";
CM_ EV_ Check_Input0 "Sprawdzanie obecnoœci samochodów na wlocie";
CM_ EV_ Check_Input10 "Czujnik obecnoœci pieszych na wlocie";
CM_ EV_ Check_Input11 "Czujnikobecnoœci pieszych na wlocie";
CM_ EV_ Check_Input12 "Czujnik obecnoœci pieszych na wlocie";
CM_ EV_ Check_Input13 "Czujnik obecnoœci pieszych na wlocie";
CM_ EV_ Check_Input14 "Czujnik obecnoœci pieszych na wlocie";
CM_ EV_ Check_Input15 "Czujnik obecnoœci pieszych na wlocie";
CM_ EV_ Check_Input16 "Czujnik obecnoœci pieszych na wlocie";
CM_ EV_ Check_Input5 "Czujnik obecnoœci samochodów na wlocie";
CM_ EV_ Check_Input6 "Czujnik obecnoœci samochodów na wlocie";
CM_ EV_ Check_Input7 "Czujnik obecnoœci samochodów na wlocie";
CM_ EV_ Check_Input8 "Czujnik obecnoœci samochodów na wlocie";
CM_ EV_ Check_Input9 "Czujnikobecnoœci samochodów na wlocie";
CM_ EV_ Check_Input4 "Czujnik obecnoœci samochodów na wlocie";
CM_ EV_ Check_Input3 "Czujnik obecnoœci samochodów na wlocie";
CM_ EV_ Check_Input2 "Czujnik obecnoœci samochodów na wlocie";
CM_ EV_ Check_Input1 "Czujnik obecnoœci samochodów na wlocie";
CM_ EV_ Check_Input17 "Czujnik obecnoœci pieszych na wlocie";
CM_ EV_ Check_Output0 "Blokada wylotu 0";
CM_ EV_ Check_Output3 "Blokada wylotu 3";
CM_ EV_ Check_Output2 "Blokada wylotu 2";
CM_ EV_ Check_Output1 "Blokada wylotu 1";
CM_ EV_ Tyellow "Czas œwiat³a ¿ó³tego.";
CM_ EV_ Tmax "Maksymalny czas œwiat³a zielonego.";
CM_ EV_ Tmin "Minimalny czas œwiat³a zielonego.";
SIG_VALTYPE_ 77 time : 1;
