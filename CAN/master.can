/*@!Encoding:1250*/
includes
{
  
}

variables
{  
  // stałe
  const int inputsAmountCars = 10; // liczby wlotów
  const int inputsAmountWalkers = 8; 
  const int arrowsAmount = 4;
  const int cyclesAmount = 4; // liczba dostępnych wariantów cykli
  const int cyclePhases = 4; // liczba faz w cyklu
  
  // kopie danych z czujników
  int cIC[inputsAmountCars];
  int cIW[inputsAmountWalkers];
  
  // macierze cykli
  double B[cyclesAmount][inputsAmountCars+inputsAmountWalkers+arrowsAmount][cyclePhases];
  double invB[cyclesAmount][cyclePhases][cyclePhases];
  
  // zmienne cyklu
  int currentCycle; // identyfikator wybranego cyklu
  int currentPhase; // aktualna faza cyklu
  double x[cyclePhases]; // wektor wyjściowy (czasy poszczególnych faz cyklu)
  
  int SensorsActive; //1 - sensors polaczone, 0 - sensors odlaczone 
  int SlaveActive; //1 - slave polaczone, 0 - slave odlaczone 
}

double max(double a, double b) { return a >= b ? a : b; }
double min(double a, double b) { return a >= b ? b : a; }

on start
{
  currentCycle = 0;
  currentPhase = 0;
  
  PrepareCycles();
  SensorsActive = 1;
  SlaveActive = 1;
}

void PrepareCycles()
{
  // przygotowanie macierzy reprezentujących cykle
  
  // wyzerowanie wszystkich macierzy
  int i, j, k;
  for (i = 0; i < cyclesAmount; i++)
    for (j = 0; j < inputsAmountCars+inputsAmountWalkers+arrowsAmount; j++)
      for (k = 0; k < cyclePhases; k++)
        B[i][j][k] = 0;
  
  // wartości odpowiedzialne za wloty samochodowe i przejścia dla pieszych
     
  // zrównoważony
  B[0][0][0] = B[0][1][0] = B[0][5][0] = B[0][6][0] = B[0][12][0] = B[0][13][0] = B[0][16][0] = B[0][17][0] = 1;
  B[0][2][1] = B[0][7][1] = B[0][11][1] = B[0][12][1] = B[0][15][1] = B[0][16][1] = 1;
  B[0][3][2] = B[0][8][2] = B[0][10][2] = B[0][11][2] = B[0][14][2] = B[0][15][2] = 1;
  B[0][4][3] = B[0][9][3] = B[0][10][3] = B[0][13][3] = B[0][14][3] = B[0][17][3] = 1;
      
  // asymetryczny na głównej
  B[1][0][0] = B[1][1][0] = B[1][2][0] = B[1][11][0] = B[1][12][0] = B[1][14][0] = B[1][16][0] = B[1][17][0] = 1;
  B[1][5][1] = B[1][6][1] = B[1][7][1] = B[1][10][1] = B[1][12][1] = B[1][13][1] = B[1][15][1] = B[1][16][1] = 1;
  B[1][3][2] = B[1][8][2] = B[1][10][2] = B[1][11][2] = B[1][14][2] = B[1][15][2] = 1;
  B[1][4][3] = B[1][9][3] = B[1][10][3] = B[1][13][3] = B[1][14][3] = B[1][17][3] = 1;
      
  // asymetryczny na podrzędnej
  B[2][0][0] = B[2][1][0] = B[2][5][0] = B[2][6][0] = B[2][12][0] = B[2][13][0] = B[2][16][0] = B[2][17][0] = 1;
  B[2][2][1] = B[2][7][1] = B[2][11][1] = B[2][12][1] = B[2][15][1] = B[2][16][1] = 1;
  B[2][3][2] = B[2][4][2] = B[2][10][2] = B[2][11][2] = B[2][13][2] = B[2][14][2] = B[2][16][2] = 1;
  B[2][8][3] = B[2][9][3] = B[2][10][3] = B[2][12][3] = B[2][14][3] = B[2][15][3] = B[2][17][3] = 1;
      
  // asymetryczny zupełny
  B[3][0][0] = B[3][1][0] = B[3][2][0] = B[3][11][0] = B[3][12][0] = B[3][14][0] = B[3][16][0] = B[3][17][0] = 1;
  B[3][5][1] = B[3][6][1] = B[3][7][1] = B[3][10][1] = B[3][12][1] = B[3][13][1] = B[3][15][1] = B[3][16][1] = 1;
  B[3][3][2] = B[3][4][2] = B[3][10][2] = B[3][11][2] = B[3][13][2] = B[3][14][2] = B[3][16][2] = 1;
  B[3][8][3] = B[3][9][3] = B[3][10][3] = B[3][12][3] = B[3][14][3] = B[3][15][3] = B[3][17][3] = 1;
  
  // wartości odpowiedzialne za strzałki warunkowe
      
  for (i = 0; i < cyclesAmount; i++)
    for (j = inputsAmountCars+inputsAmountWalkers; j < inputsAmountCars+inputsAmountWalkers+arrowsAmount; j++)
      for (k = 0; k < cyclePhases; k++)
        B[i][j][k] = 1;
  
  B[0][18][0] = B[0][20][0] = B[0][19][2] = B[0][21][2] = 0;
  B[1][18][0] = B[1][20][1] = B[1][19][2] = B[1][21][2] = 0;
  B[2][18][0] = B[2][20][0] = B[2][19][2] = B[2][21][3] = 0;
  B[3][18][0] = B[3][20][1] = B[3][19][2] = B[3][21][3] = 0;
}

on envVar Sensors_On_Off
{
  if(getValue(this) == 1)
    SensorsActive = 1;
  else SensorsActive = 0;
}

on envVar Slave_On_Off
{
  $MasterConnectSlave::Connect_Slave = SlaveActive = getValue(this);
}

//sygnal resetujacy po podlaczeniu slave
on message SlaveConnectMaster 
{
  SetRedLights();
  currentCycle = 0;
  currentPhase = 0;
}

int IsAnyoneWaiting()
{
  int i;
  
  for (i = 0; i < inputsAmountCars; i++)
    if (cIC[i])
      return 1;
    
  for (i = 0; i < inputsAmountWalkers; i++)
    if (cIW[i])
      return 1;
    
  return 0;
}

int AreThereAnyWalkers(int mat, int phase)
{
  int i;
  
  for (i = 0; i < inputsAmountWalkers; i++)
    if (cIW[i] && B[mat][inputsAmountCars+i][phase] > 0)
      return 1;
  
  return 0;
}

void ProcessWalkers()
{
  if (AreThereAnyWalkers(currentCycle, currentPhase))
    if (x[currentPhase] < getValue(TminP))
        x[currentPhase] = getValue(TminP);
}

on key*
{
  if(SlaveActive == 1)
  {
    if (IsAnyoneWaiting() || SensorsActive == 0)
    {    
      if (currentPhase == 0)
        ChooseBestCycle();
      
      ProcessWalkers();
      
      if (x[currentPhase] > 0)
        TranslateCycleToMessage();
      
      currentPhase = (currentPhase+1) % cyclePhases;
    }
    else
    {
      currentPhase = 0;
      SetRedLights();
      write("Noone waiting");
    }
  }
}

void ChooseBestCycle()
{
  int i, j, k;
  double tmp;
  
  double Tc; // czas całkowity cyklu
  double Tp; // czas żółtego światła
  double x_min; // minimalny czas zielonego światła bez pieszych
  double x_max; // maksymalny czas zielonego światła
  double eff; // przepustowość
  double v[inputsAmountCars]; // wektor współczynników
  
  if(SensorsActive == 0)
  {
    currentCycle = 0;
    x[0] = x[1] = x[2] = x[3] = getValue(T_faza_awaryjna);
  }
  else
  {
    Tc = getValue(Tcycle);
    Tp = getValue(Tyellow);
    x_min = getValue(Tmin);
    x_max = getValue(Tmax);
    
    for (i = 0; i < inputsAmountCars; i++)
      v[i] = (double)cIC[i];
    
    currentCycle = 0;
    eff = 0;
    
    for (i = 0; i < cyclesAmount; i++)
    {
      tmp = Proceed(v, i, x, x_min, x_max, Tc, Tp);
      
      if (eff < tmp)
      {
        eff = tmp;
        currentCycle = i;
      }
    }
    
    eff = Proceed(v, currentCycle, x, x_min, x_max, Tc, Tp);
  }
  
  Write("Choosing best cycle: %d", currentCycle);
  Write("%lf %lf %lf %lf %lf", x[0], x[1], x[2], x[3], eff);
}

double t_ps(double n) { return 2.15*n+3.65; }
double n(double tps) { return (tps-3.65)/2.15; }

double Proceed(
  double v[], // wektor natężeń ruchu
  int mat,  // identyfikator sprawdzanej macierzy
  double x[],
  double x_min,
  double x_max,
  double Tc,
  double Tp)
{
  // zmienne
  int i, j;
  double t_cycl;
  double u;
  double sum_m;
  double sum_b;
  double eff;
  double total_cycle_time;
  
  // maksymalna liczba samochodów oczekująca 
  // w poszczególnych fazach
  // na pojedynczym pasie
  double m[4];
  
  for (j = 0; j < 4; j++)
  {
    m[j] = 0;
    for (i = 0; i < inputsAmountCars; i++)
      if (m[j] < B[mat][i][j]*v[i])
          m[j] = B[mat][i][j]*v[i];
  }
  
  // obliczenie przewidywanego czasu cyklu
  t_cycl = 0;
  for (i = 0; i < 4; i++)
    if (m[i] > 0)
      t_cycl += t_ps(m[i]);
  
  // obliczenie współczynnika skalowania
  u = min((Tc-4*Tp)/t_cycl, 1);
  
  // średnia liczba samochodów oczekująca w poszczególnych fazach na pojedynczym pasie
  for (j = 0; j < 4; j++)
  {
    m[j] = 0;
    for (i = 0; i < inputsAmountCars; i++)
      m[j] += B[mat][i][j]*v[i];
    
    sum_b = 0;
    for (i = 0; i < inputsAmountCars; i++)
      sum_b += B[mat][i][j];
    
    m[j] /= sum_b;
  }
  
  // suma samochodów oczekujących
  sum_m = 0;
  for (j = 0; j < 4; j++)
    sum_m += m[j];
  
  // obliczenie czasów dla faz cyklu
  for (j = 0; j < 4; j++)
  {
    x[j] = u*t_cycl*m[j] / sum_m;
    
    // uwzględnienie ograniczeń
      if (m[j] == 0)
          x[j] = 0;
      else if (x[j] < x_min)
               x[j] = x_min;
      else if (x[j] > x_max)
               x[j] = x_max;
  }
  
  // obliczenie przepustowości (liczba samochodów, która przejechała)
  eff = 0;
  for (j = 0; j < 4; j++)
    for (i = 0; i < inputsAmountCars; i++)
      if (x[j] > 0)
        eff += B[mat][i][j]*min(n(x[j]), v[i]);
    
  // czas trwania cyklu
  total_cycle_time = 4*Tp;
  for (j = 0; j < 4; j++)
    total_cycle_time += x[j];
  
  eff *= 60/total_cycle_time;
  
  return eff;
}

// komunikacja z sensorami (odczyt danych do pamięci wewnętrznej)
on message SensorsDataCars
{
  cIC[0] = $SensorsDataCars::C_Input00;
  cIC[1] = $SensorsDataCars::C_Input01;
  cIC[2] = $SensorsDataCars::C_Input02;
  cIC[3] = $SensorsDataCars::C_Input03;
  cIC[4] = $SensorsDataCars::C_Input04;
  cIC[5] = $SensorsDataCars::C_Input05;
  cIC[6] = $SensorsDataCars::C_Input06;
  cIC[7] = $SensorsDataCars::C_Input07;
  cIC[8] = $SensorsDataCars::C_Input08;
  cIC[9] = $SensorsDataCars::C_Input09;
}

on message SensorsDataWalkers
{
  cIW[0] = $SensorsDataWalkers::C_Input10;
  cIW[1] = $SensorsDataWalkers::C_Input11;
  cIW[2] = $SensorsDataWalkers::C_Input12;
  cIW[3] = $SensorsDataWalkers::C_Input13;
  cIW[4] = $SensorsDataWalkers::C_Input14;
  cIW[5] = $SensorsDataWalkers::C_Input15;
  cIW[6] = $SensorsDataWalkers::C_Input16;
  cIW[7] = $SensorsDataWalkers::C_Input17;
}

// komunikacja ze slavem (wysyłane rozkazów)
void TranslateCycleToMessage()
{
  int tmp[8];
  
  // sygnały dla samochodów
  $CyclePhase::time = x[currentPhase];
  $CyclePhase::input0 = (int)B[currentCycle][0][currentPhase];
  $CyclePhase::input1 = (int)B[currentCycle][1][currentPhase];
  $CyclePhase::input2 = (int)B[currentCycle][2][currentPhase];
  $CyclePhase::input3 = (int)B[currentCycle][3][currentPhase];
  $CyclePhase::input4 = (int)B[currentCycle][4][currentPhase];
  $CyclePhase::input5 = (int)B[currentCycle][5][currentPhase];
  $CyclePhase::input6 = (int)B[currentCycle][6][currentPhase];
  $CyclePhase::input7 = (int)B[currentCycle][7][currentPhase];
  $CyclePhase::input8 = (int)B[currentCycle][8][currentPhase];
  $CyclePhase::input9 = (int)B[currentCycle][9][currentPhase];
  
  // sygnały dla pieszych
  $CyclePhase::input10 = tmp[0] = (int)B[currentCycle][10][currentPhase] && cIW[0]; if (tmp[0]) putValue(Check_Input10, 0);
  $CyclePhase::input11 = tmp[1] = (int)B[currentCycle][11][currentPhase] && cIW[1]; if (tmp[1]) putValue(Check_Input11, 0);
  $CyclePhase::input12 = tmp[2] = (int)B[currentCycle][12][currentPhase] && cIW[2]; if (tmp[2]) putValue(Check_Input12, 0);
  $CyclePhase::input13 = tmp[3] = (int)B[currentCycle][13][currentPhase] && cIW[3]; if (tmp[3]) putValue(Check_Input13, 0);
  $CyclePhase::input14 = tmp[4] = (int)B[currentCycle][14][currentPhase] && cIW[4]; if (tmp[4]) putValue(Check_Input14, 0);
  $CyclePhase::input15 = tmp[5] = (int)B[currentCycle][15][currentPhase] && cIW[5]; if (tmp[5]) putValue(Check_Input15, 0);
  $CyclePhase::input16 = tmp[6] = (int)B[currentCycle][16][currentPhase] && cIW[6]; if (tmp[6]) putValue(Check_Input16, 0);
  $CyclePhase::input17 = tmp[7] = (int)B[currentCycle][17][currentPhase] && cIW[7]; if (tmp[7]) putValue(Check_Input17, 0);
  
  // dodatkowe sygnały dla pieszych
  if ((int)B[currentCycle][10][currentPhase] && tmp[1]) { $CyclePhase::input10 = 1; putValue(Check_Input10, 0); }
  if ((int)B[currentCycle][11][currentPhase] && tmp[0]) { $CyclePhase::input11 = 1; putValue(Check_Input11, 0); }
  if ((int)B[currentCycle][12][currentPhase] && tmp[3]) { $CyclePhase::input12 = 1; putValue(Check_Input12, 0); }
  if ((int)B[currentCycle][13][currentPhase] && tmp[2]) { $CyclePhase::input13 = 1; putValue(Check_Input13, 0); }
  if ((int)B[currentCycle][14][currentPhase] && tmp[5]) { $CyclePhase::input14 = 1; putValue(Check_Input14, 0); }
  if ((int)B[currentCycle][15][currentPhase] && tmp[4]) { $CyclePhase::input15 = 1; putValue(Check_Input15, 0); }
  if ((int)B[currentCycle][16][currentPhase] && tmp[7]) { $CyclePhase::input16 = 1; putValue(Check_Input16, 0); }
  if ((int)B[currentCycle][17][currentPhase] && tmp[6]) { $CyclePhase::input17 = 1; putValue(Check_Input17, 0); }
  
  // sygnały dla strzałek warunkowych - 0,3,5,8
  $CyclePhase::input18 = (int)B[currentCycle][18][currentPhase];
  $CyclePhase::input19 = (int)B[currentCycle][19][currentPhase];
  $CyclePhase::input20 = (int)B[currentCycle][20][currentPhase];
  $CyclePhase::input21 = (int)B[currentCycle][21][currentPhase];
    
  Write("Cycle activated: %d, phase %d", currentCycle, currentPhase);
}

void SetRedLights()
{
  $CyclePhase::time = 0;
  $CyclePhase::input0 = 0;
  $CyclePhase::input1 = 0;
  $CyclePhase::input2 = 0;
  $CyclePhase::input3 = 0;
  $CyclePhase::input4 = 0;
  $CyclePhase::input5 = 0;
  $CyclePhase::input6 = 0;
  $CyclePhase::input7 = 0;
  $CyclePhase::input8 = 0;
  $CyclePhase::input9 = 0;
  $CyclePhase::input10 = 0;
  $CyclePhase::input11 = 0;
  $CyclePhase::input12 = 0;
  $CyclePhase::input13 = 0;
  $CyclePhase::input14 = 0;
  $CyclePhase::input15 = 0;
  $CyclePhase::input16 = 0;
  $CyclePhase::input17 = 0;
  
  $CyclePhase::input18 = 0;
  $CyclePhase::input19 = 0;
  $CyclePhase::input20 = 0;
  $CyclePhase::input21 = 0;
}