/*@!Encoding:1250*/
includes
{
  
}

variables
{
  // stałe
  const int inputsAmount = 18; // liczba wlotów (przejścia dla pieszych traktowane jako wloty)
  const int outputsAmount = 4; // liczba wylotów
  const int cyclesAmount = 4; // liczba dostępnych wariantów cykli
  const int maxCyclePhases = 4; // maksymalna liczba faz w cyklu
  
  // macierze cykli
  double B[cyclesAmount][inputsAmount][maxCyclePhases];
  double invB[cyclesAmount][maxCyclePhases][maxCyclePhases];
  
  // zmienne cyklu
  int currentCyclePhases; // liczba faz w aktualnym cyklu
  int currentPhase; // aktualna faza cyklu (-1 = poprzedni cykl się skończył)
}

on start
{
  currentPhase = -1;
  PrepareCycles();
  ChooseBestCycle();
}

void PrepareCycles()
{
  // przygotowanie macierzy reprezentujących cykle
  
  // wyzerowanie wszystkich macierzy
  int i, j, k;
  for (i = 0; i < cyclesAmount; i++)
    for (j = 0; j < inputsAmount; j++)
      for (k = 0; k < maxCyclePhases; k++)
        B[i][j][k] = 0;
  
  // zrównoważony
  B[0][0][0] = B[0][1][0] = B[0][5][0] = B[0][6][0] = B[0][12][0] = B[0][13][0] = B[0][16][0] = B[0][17][0] = 1;
  B[0][2][1] = B[0][7][1] = B[0][12][1] = B[0][16][1] = 1;
  B[0][3][2] = B[0][4][2] = B[0][8][2] = B[0][9][2] = B[0][10][2] = B[0][11][2] = B[0][14][2] = B[0][15][2] = 1;
  B[0][4][3] = B[0][9][3] = B[0][10][3] = B[0][14][3] = 1;
      
  // asymetryczny na głównej
  B[1][0][0] = B[1][1][0] = B[1][2][0] = B[1][12][0] = B[1][16][0] = B[1][17][0] = 1;
  B[1][5][1] = B[1][6][1] = B[1][7][1] = B[1][12][1] = B[1][13][1] = B[1][16][1] = 1;
  B[1][3][2] = B[1][4][2] = B[1][8][2] = B[1][9][2] = B[1][10][2] = B[1][11][2] = B[1][14][2] = B[1][15][2] = 1;
  B[1][4][3] = B[1][9][3] = B[1][10][3] = B[1][14][3] = 1;
      
  // asymetryczny na podrzędnej
  B[2][0][0] = B[2][1][0] = B[2][5][0] = B[2][6][0] = B[2][12][0] = B[2][13][0] = B[2][16][0] = B[2][17][0] = 1;
  B[2][2][1] = B[2][7][1] = B[2][12][1] = B[2][16][1] = 1;
  B[2][3][2] = B[2][4][2] = B[2][10][2] = B[2][11][2] = B[2][13][2] = B[2][14][2] = B[2][16][2] = 1;
  B[2][8][3] = B[2][9][3] = B[2][10][3] = B[2][12][3] = B[2][14][3] = B[2][15][3] = B[2][17][3] = 1;
      
  // asymetryczny zupełny
  B[3][0][0] = B[3][1][0] = B[3][2][0] = B[3][11][0] = B[3][12][0] = B[3][14][0] = B[3][16][0] = 1;
  B[3][3][1] = B[3][4][1] = B[3][10][1] = B[3][13][1] = B[3][14][1] = B[3][16][1] = 1;
  B[3][5][2] = B[3][6][2] = B[3][7][2] = B[3][9][2] = B[3][10][2] = B[3][12][2] = B[3][15][2] = B[3][16][2] = 1;
  B[3][8][3] = B[3][9][3] = B[3][10][3] = B[3][12][3] = B[3][14][3] = B[3][17][3] = 1;
  
  for (i = 0; i < cyclesAmount; i++)
    PrepareInversedMatrix(i);
}

void PrepareInversedMatrix(int mat)
{
  // iteratory
  int i, j, k;
  double t;
  
  // dla ułatwienia
  const int m = maxCyclePhases;
  
  // macierz do odwrócenia
  double tmpM[m][m];
  
  // wypełnienie macierzy do odwrócenia
  for (i = 0; i < m; i++)
    for (j = 0; j < m; j++)
    {
      tmpM[i][j] = 0;
      
      for (k = 0; k < inputsAmount; k++)
        tmpM[i][j] += B[mat][k][i]*B[mat][k][j];
    }
  
  // przygotowanie macierzy jednostkowej
  for (i = 0; i < m; i++)
    for (j = 0; j < m; j++)
      invB[mat][i][j] = (i == j ? 1 : 0);
    
  // odwracanie macierzy metodą eliminacji Gaussa
  for (i = 0; i+1 < m; i++)
  {
    if (tmpM[i][i] == 0)
      for (j = i+1; j < m; j++)
        if (tmpM[j][i] != 0)
          for (k = 0; k < m; k++)
          {
            t = tmpM[i][k];
            tmpM[i][k] = tmpM[j][k];
            tmpM[j][k] = t;
            t = invB[mat][i][k];
            invB[mat][i][k] = invB[mat][j][k];
            invB[mat][j][k] = t;
          }
          
     if (tmpM[i][i] != 0)
      for (j = i+1; j < m; j++)
      {
        t = tmpM[j][i]/tmpM[i][i];
        
        for (k = i; k < m; k++)
          tmpM[j][k] -= tmpM[i][k]*t;
        
        for (k = 0; k < m; k++)
          invB[mat][j][k] -= invB[mat][i][k]*t;
      }
  }
  
  for (i = m-1; i > 0; i--)
    for (j = 0; j < i; j++)
    {
      t = tmpM[j][i]/tmpM[i][i];
      
      for (k = 0; k < m; k++)
        invB[mat][j][k] -= t*invB[mat][i][k];
    }
    
  for (i = 0; i < m; i++)
    for (j = 0; j < m; j++)
      invB[mat][i][j] /= tmpM[i][i];
}

double Proceed(
  double v[], // wektor natężeń ruchu
  int mat,  // identyfikator sprawdzanej macierzy
  double x[],
  double x_min,
  double x_max,
  double Tc,
  double Tp)
{
  // iteratory
  int i, j, k;
  
  // skrócone nazwy dla ułatwienia
  const int n = inputsAmount;
  const int m = cyclesAmount;
  
  double tmp = 0.0;
  double s = 0.0;
  double deltaV;
  
  double vector[m];
  double dv[n];
  
  // przygotowanie wektora współczynników
  for (i = 0; i < m; i++)
  {
    vector[i] = 0;
    
    for (j = 0; j < n; j++)
      vector[i] += B[mat][j][i]*v[j];
  }
  
  // x = invB*vector
  for (i = 0; i < m; i++)
  {
    x[i] = 0;
    
    for (j = 0; j < m; j++)
      x[i] += invB[mat][i][j]*vector[j];
  }
  
  // obliczenie stałej s
  for (i = 0; i < m; i++)
    tmp += x[i];
  s = (Tc-m*Tp)/tmp;
  
  Write("S%lf", tmp);
  
  // przeskalowanie wektora i uwzględnienie ograniczeń
  for (i = 0; i < m; i++)
  {
    x[i] *= s;
    
    if (x[i] < x_min)
      x[i] = x_min;
    if (x[i] > x_max)
      x[i] = x_max;
  }
  
  // obliczenie błędu
  for (i = 0; i < n; i++)
  {
    dv[i] = 0;
    
    for (j = 0; j < m; j++)
      dv[i] += B[mat][i][j]*x[j]-v[i]*s;
  }
  deltaV = 0;
  for (i = 0; i < n; i++)
    deltaV += dv[i]*dv[i];
  
  return sqrt(deltaV);
}

void ChooseBestCycle()
{
  int i,j;
  double tmp;
  
  double Tc = 60; // czas całkowity cyklu
  double Tp = 3; // czas żółtego światła
  double x_min = 5; // minimalny czas zielonego światła
  double x_max = 20; // maksymalny czas zielonego światła
  double deltaV = 10000000; // niedokładność
  double v[inputsAmount]; // wektor natężeń ruchu
  double x[maxCyclePhases]; // wektor wyjściowy (czasy poszczególnych faz cyklu)
  
  int mat = 0;
  
  for (i = 0; i < inputsAmount; i++)
    v[i] = 20;
  
  for (i = 0; i < cyclesAmount; i++)
  {
    tmp = Proceed(v, i, x, x_min, x_max, Tc, Tp);
    Write("cykl: %d - blad: %lf", i, tmp);
    
    if (deltaV > tmp)
    {
      deltaV = tmp;
      mat = i;
    }
  }
  mat = 1;
  Proceed(v, mat, x, x_min, x_max, Tc, Tp);
  
  Write("wybrany cykl: %d", mat);
  Write("blad: %lf", deltaV);
  for (i = 0; i < cyclesAmount; i++)
    Write("%lf ", x[i]);
  for (i = 0; i < inputsAmount; i++)
  {
    tmp = 0;
    for (j = 0; j < cyclesAmount; j++)
      tmp += B[mat][i][j]*x[j];
    
    Write("input%d: %lf", i, tmp);
  }
}