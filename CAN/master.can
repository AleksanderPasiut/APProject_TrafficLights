/*@!Encoding:1250*/
includes
{
  
}

variables
{  
  // stałe
  const int inputsAmountCars = 10; // liczby wlotów
  const int inputsAmountWalkers = 8; 
  const int arrowsAmount = 4;
  const int outputsAmount = 4; // liczba wylotów
  const int cyclesAmount = 4; // liczba dostępnych wariantów cykli
  const int cyclePhases = 4; // liczba faz w cyklu
  
  // kopie danych z czujników
  int cIC[inputsAmountCars];
  int cIW[inputsAmountWalkers];
  int cO[outputsAmount];
  
  // macierze cykli
  double B[cyclesAmount][inputsAmountCars+inputsAmountWalkers+arrowsAmount][cyclePhases];
  double invB[cyclesAmount][cyclePhases][cyclePhases];
  
  // zmienne cyklu
  int currentCycle; // identyfikator wybranego cyklu
  int currentPhase; // aktualna faza cyklu
  double x[cyclePhases]; // wektor wyjściowy (czasy poszczególnych faz cyklu)
  
  int SensorsActive; //1 - sensors polaczone, 0 - sensors odlaczone 
  int SlaveActive; //1 - slave polaczone, 0 - slave odlaczone 
  
}

double max(double a, double b)
{
  return a >= b ? a : b;
}

on start
{
  currentCycle = 0;
  currentPhase = 0;
  
  PrepareCycles();
  SensorsActive = 1;
  SlaveActive = 1;
}

void PrepareCycles()
{
  // przygotowanie macierzy reprezentujących cykle
  
  // wyzerowanie wszystkich macierzy
  int i, j, k;
  for (i = 0; i < cyclesAmount; i++)
    for (j = 0; j < inputsAmountCars+inputsAmountWalkers+arrowsAmount; j++)
      for (k = 0; k < cyclePhases; k++)
        B[i][j][k] = 0;
  
  // wartości odpowiedzialne za wloty samochodowe i przejścia dla pieszych
     
  // zrównoważony
  B[0][0][0] = B[0][1][0] = B[0][5][0] = B[0][6][0] = B[0][12][0] = B[0][13][0] = B[0][16][0] = B[0][17][0] = 1;
  B[0][2][1] = B[0][7][1] = B[0][11][1] = B[0][12][1] = B[0][15][1] = B[0][16][1] = 1;
  B[0][3][2] = B[0][8][2] = B[0][10][2] = B[0][11][2] = B[0][14][2] = B[0][15][2] = 1;
  B[0][4][3] = B[0][9][3] = B[0][10][3] = B[0][13][3] = B[0][14][3] = B[0][17][3] = 1;
      
  // asymetryczny na głównej
  B[1][0][0] = B[1][1][0] = B[1][2][0] = B[1][11][0] = B[1][12][0] = B[1][14][0] = B[1][16][0] = B[1][17][0] = 1;
  B[1][5][1] = B[1][6][1] = B[1][7][1] = B[1][10][1] = B[1][12][1] = B[1][13][1] = B[1][15][1] = B[1][16][1] = 1;
  B[1][3][2] = B[1][8][2] = B[1][10][2] = B[1][11][2] = B[1][14][2] = B[1][15][2] = 1;
  B[1][4][3] = B[1][9][3] = B[1][10][3] = B[1][13][3] = B[1][14][3] = B[1][17][3] = 1;
      
  // asymetryczny na podrzędnej
  B[2][0][0] = B[2][1][0] = B[2][5][0] = B[2][6][0] = B[2][12][0] = B[2][13][0] = B[2][16][0] = B[2][17][0] = 1;
  B[2][2][1] = B[2][7][1] = B[2][11][1] = B[2][12][1] = B[2][15][1] = B[2][16][1] = 1;
  B[2][3][2] = B[2][4][2] = B[2][10][2] = B[2][11][2] = B[2][13][2] = B[2][14][2] = B[2][16][2] = 1;
  B[2][8][3] = B[2][9][3] = B[2][10][3] = B[2][12][3] = B[2][14][3] = B[2][15][3] = B[2][17][3] = 1;
      
  // asymetryczny zupełny
  B[3][0][0] = B[3][1][0] = B[3][2][0] = B[3][11][0] = B[3][12][0] = B[3][14][0] = B[3][16][0] = B[3][17][0] = 1;
  B[3][5][1] = B[3][6][1] = B[3][7][1] = B[3][10][1] = B[3][12][1] = B[3][13][1] = B[3][15][1] = B[3][16][1] = 1;
  B[3][3][2] = B[3][4][2] = B[3][10][2] = B[3][11][2] = B[3][13][2] = B[3][14][2] = B[3][16][2] = 1;
  B[3][8][3] = B[3][9][3] = B[3][10][3] = B[3][12][3] = B[3][14][3] = B[3][15][3] = B[3][17][3] = 1;
  
  // wartości odpowiedzialne za strzałki warunkowe
      
  for (i = 0; i < cyclesAmount; i++)
    for (j = inputsAmountCars+inputsAmountWalkers; j < inputsAmountCars+inputsAmountWalkers+arrowsAmount; j++)
      for (k = 0; k < cyclePhases; k++)
        B[i][j][k] = 1;
  
  B[0][18][0] = B[0][20][0] = B[0][19][2] = B[0][21][2] = 0;
  B[1][18][0] = B[1][20][1] = B[1][19][2] = B[1][21][2] = 0;
  B[2][18][0] = B[2][20][0] = B[2][19][2] = B[2][21][3] = 0;
  B[3][18][0] = B[3][20][1] = B[3][19][2] = B[3][21][3] = 0;
      
  for (i = 0; i < cyclesAmount; i++)
    PrepareInversedMatrix(i);
}

void PrepareInversedMatrix(int mat)
{
  // iteratory
  int i, j, k;
  double t;
  
  // dla ułatwienia
  const int m = cyclePhases;
  
  // macierz do odwrócenia
  double tmpM[m][m];
  
  // wypełnienie macierzy do odwrócenia
  for (i = 0; i < m; i++)
    for (j = 0; j < m; j++)
    {
      tmpM[i][j] = 0;
      
      for (k = 0; k < inputsAmountCars; k++)
        tmpM[i][j] += B[mat][k][i]*B[mat][k][j];
    }
  
  // przygotowanie macierzy jednostkowej
  for (i = 0; i < m; i++)
    for (j = 0; j < m; j++)
      invB[mat][i][j] = (i == j ? 1 : 0);
    
  // odwracanie macierzy metodą eliminacji Gaussa
  for (i = 0; i+1 < m; i++)
  {
    if (tmpM[i][i] == 0)
      for (j = i+1; j < m; j++)
        if (tmpM[j][i] != 0)
          for (k = 0; k < m; k++)
          {
            t = tmpM[i][k];
            tmpM[i][k] = tmpM[j][k];
            tmpM[j][k] = t;
            t = invB[mat][i][k];
            invB[mat][i][k] = invB[mat][j][k];
            invB[mat][j][k] = t;
          }
          
     if (tmpM[i][i] != 0)
      for (j = i+1; j < m; j++)
      {
        t = tmpM[j][i]/tmpM[i][i];
        
        for (k = i; k < m; k++)
          tmpM[j][k] -= tmpM[i][k]*t;
        
        for (k = 0; k < m; k++)
          invB[mat][j][k] -= invB[mat][i][k]*t;
      }
  }
  
  for (i = m-1; i > 0; i--)
    for (j = 0; j < i; j++)
    {
      t = tmpM[j][i]/tmpM[i][i];
      
      for (k = 0; k < m; k++)
        invB[mat][j][k] -= t*invB[mat][i][k];
    }
    
  for (i = 0; i < m; i++)
    for (j = 0; j < m; j++)
      invB[mat][i][j] /= tmpM[i][i];
}

on envVar Sensors_On_Off
{
  if(getValue(this) == 1)
  {
    SensorsActive = 1;
  }
  else
  {
    SensorsActive = 0;
    
    currentPhase = 0;
    LoadSensorDataKernel();
  }
}

on envVar Slave_On_Off
{
  if(getValue(this) == 1)
  {
    SlaveActive = 1;
    $MasterConnectSlave::Connect_Slave = 1;
  }
  else
  {
    $MasterConnectSlave::Connect_Slave = 0;
    SlaveActive = 0;
  }
}

//sygnal resetujacy po podlaczeniu slave
on message SlaveConnectMaster 
{
  SetRedLights();
  currentCycle = 0;
  currentPhase = 0;
  
  LoadSensorDataKernel();
}

on key*
{
  if(SlaveActive == 1)
  {
    if (currentPhase == 0)
      LoadSensorDataKernel();
    else OnKey();
  }
}

void LoadSensorDataKernel()
{
  $RequestSensorsData::OK = 1;
}

on message SensorsDataOutputs
{  
  cO[0] = $SensorsDataOutputs::C_Output0;
  cO[1] = $SensorsDataOutputs::C_Output1;
  cO[2] = $SensorsDataOutputs::C_Output2;
  cO[3] = $SensorsDataOutputs::C_Output3;
  
  write("Output sensors read");
}

on message SensorsDataCars
{
  cIC[0] = (cO[2] && cO[3])  ? $SensorsDataCars::C_Input00 : 0;
  cIC[1] = cO[2]             ? $SensorsDataCars::C_Input01 : 0;
  cIC[2] = cO[1]             ? $SensorsDataCars::C_Input02 : 0;
  cIC[3] = (cO[0] && cO[3])  ? $SensorsDataCars::C_Input03 : 0;
  cIC[4] = (cO[2] && cO[3])  ? $SensorsDataCars::C_Input04 : 0;
  cIC[5] = (cO[0] && cO[1])  ? $SensorsDataCars::C_Input05 : 0;
  cIC[6] = cO[0]             ? $SensorsDataCars::C_Input06 : 0;
  cIC[7] = cO[3]             ? $SensorsDataCars::C_Input07 : 0;
  cIC[8] = (cO[1] && cO[2])  ? $SensorsDataCars::C_Input08 : 0;
  cIC[9] = (cO[0] && cO[1])  ? $SensorsDataCars::C_Input09 : 0;
  
  write("Car sensors read");
}

on message SensorsDataWalkers
{
  cIW[0] = $SensorsDataWalkers::C_Input10;
  cIW[1] = $SensorsDataWalkers::C_Input11;
  cIW[2] = $SensorsDataWalkers::C_Input12;
  cIW[3] = $SensorsDataWalkers::C_Input13;
  cIW[4] = $SensorsDataWalkers::C_Input14;
  cIW[5] = $SensorsDataWalkers::C_Input15;
  cIW[6] = $SensorsDataWalkers::C_Input16;
  cIW[7] = $SensorsDataWalkers::C_Input17;
  
  write("Walker sensors read");
  
  OnKey();
}

void OnKey()
{
  if(SlaveActive == 1)
  {
    if (IsAnyoneWaiting())
    {    
      if (currentPhase == 0)
      {
        DisplaySensorData();
        ChooseBestCycle();
      }
      
      if (x[currentPhase] > 0)
        TranslateCycleToMessage();
      
      currentPhase = (currentPhase+1) % cyclePhases;
    }
    else
    {
      currentPhase = 0;
      SetRedLights();
      write("Noone waiting");
    }
  }
}

int IsAnyoneWaiting()
{
  int i;
  
  for (i = 0; i < inputsAmountCars; i++)
    if (cIC[i])
      return 1;
    
  for (i = 0; i < inputsAmountWalkers; i++)
    if (cIW[i])
      return 1;
    
  return 0;
}

void DisplaySensorData()
{
  int i;
  if(SensorsActive == 1){
    
    for (i = 0; i < inputsAmountCars; i++)
      write("car input %d: %d", i, cIC[i]);
    
    for (i = 0; i < inputsAmountWalkers; i++)
      write("walker input %d: %d", i, cIW[i]);
  }
}

void ChooseBestCycle()
{
  int i, j, k;
  double tmp;
  
  double Tc; // czas całkowity cyklu
  double Tp; // czas żółtego światła
  double x_min; // minimalny czas zielonego światła bez pieszych
  double x_min_p; // minimalny czas zielonego światła z pieszymi
  double x_max; // maksymalny czas zielonego światła
  double deltaV; // niedokładność
  double v[inputsAmountCars]; // wektor współczynników
  
  if(SensorsActive == 0)
  {
    currentCycle = 0;
    x[0] = x[1] = x[2] = x[3] = getValue(T_faza_awaryjna);
  }
  else
  {
    Tc = getValue(Tcycle);
    Tp = getValue(Tyellow);
    x_min = getValue(Tmin);
    x_min_p = getValue(TminP);
    x_max = getValue(Tmax);
    
    for (i = 0; i < inputsAmountCars; i++)
      v[i] = (double)cIC[i];
    
    currentCycle = 0;
    deltaV = 10000000;
    
    for (i = 0; i < cyclesAmount; i++)
    {
      tmp = Proceed(v, i, x, x_min, x_min_p, x_max, Tc, Tp);
      
      if (deltaV > tmp)
      {
        deltaV = tmp;
        currentCycle = i;
      }
    }
    
    deltaV = Proceed(v, currentCycle, x, x_min, x_min_p, x_max, Tc, Tp);
  }
  
  Write("Choosing best cycle: %d", currentCycle);
  Write("%lf %lf %lf %lf", x[0], x[1], x[2], x[3]);
}

double Proceed(
  double v[], // wektor natężeń ruchu
  int mat,  // identyfikator sprawdzanej macierzy
  double x[],
  double x_min,
  double x_min_p,
  double x_max,
  double Tc,
  double Tp)
{
  // iteratory
  int i, j, k;
  
  // skrócone nazwy dla ułatwienia
  const int n = inputsAmountCars;
  const int m = cyclePhases;
  
  double tmp = 0.0;
  double s = 0.0;
  double deltaV;
  
  double vector[m];
  double dv[n];
  
  // przygotowanie wektora współczynników
  for (i = 0; i < m; i++)
  {
    vector[i] = 0;
    
    for (j = 0; j < n; j++)
      vector[i] += B[mat][j][i]*v[j];
  }
  
  // x = invB*vector
  for (i = 0; i < m; i++)
  {
    x[i] = 0;
    
    for (j = 0; j < m; j++)
      x[i] += invB[mat][i][j]*vector[j];
  }
  
  // obliczenie czasu trwania cyklu
  s = 0;
  for (j = 0; j < 4; j++)
  {
    tmp = 0;
    for (i = 0; i < 10; i++)
      if (tmp < B[mat][i][j]*2.15*v[i])
          tmp = B[mat][i][j]*2.15*v[i];
      
      s += tmp;
  }
  
  if (Tc > s+4*Tp)
      Tc = s+4*Tp;
  
  // obliczenie stałej s
  tmp = 0.0;
  for (i = 0; i < m; i++)
    tmp += x[i];
  
  if (tmp != 0)
    s = (Tc-4*Tp)/tmp;
  
  // przeskalowanie wektora i uwzględnienie ograniczeń
  for (i = 0; i < m; i++)
  {
    x[i] *= s;
    
    if (x[i] > x_max)
      x[i] = x_max;
    else if (AreThereAnyWalkers(mat, i))
    {
      if (x[i] < x_min_p)
        x[i] = x_min_p;
    }
    else
    {
       if (vector[i] == 0)
        x[i] = 0;
       else if (x[i] < x_min)
        x[i] = x_min;
    }
  }
  
  // obliczenie błędu
  for (i = 0; i < n; i++)
  {
    dv[i] = 0;
    
    for (j = 0; j < m; j++)
      dv[i] += B[mat][i][j]*x[j];
    
    dv[i] -= v[i]*s;
  }
  deltaV = 0;
  for (i = 0; i < n; i++)
    deltaV += dv[i]*dv[i];
 
  return sqrt(deltaV);
}

int AreThereAnyWalkers(int mat, int phase)
{
  int i;
  
  for (i = 0; i < inputsAmountWalkers; i++)
    if (cIW[i] && B[mat][inputsAmountCars+i][phase] > 0)
      return 1;
  
  return 0;
}

void TranslateCycleToMessage()
{ 
  int i;
  
  $CyclePhase::time = x[currentPhase];
  $CyclePhase::input0 = (int)B[currentCycle][0][currentPhase];
  $CyclePhase::input1 = (int)B[currentCycle][1][currentPhase];
  $CyclePhase::input2 = (int)B[currentCycle][2][currentPhase];
  $CyclePhase::input3 = (int)B[currentCycle][3][currentPhase];
  $CyclePhase::input4 = (int)B[currentCycle][4][currentPhase];
  $CyclePhase::input5 = (int)B[currentCycle][5][currentPhase];
  $CyclePhase::input6 = (int)B[currentCycle][6][currentPhase];
  $CyclePhase::input7 = (int)B[currentCycle][7][currentPhase];
  $CyclePhase::input8 = (int)B[currentCycle][8][currentPhase];
  $CyclePhase::input9 = (int)B[currentCycle][9][currentPhase];
  
  $CyclePhase::input10 = (int)B[currentCycle][10][currentPhase];
  $CyclePhase::input11 = (int)B[currentCycle][11][currentPhase];
  $CyclePhase::input12 = (int)B[currentCycle][12][currentPhase];
  $CyclePhase::input13 = (int)B[currentCycle][13][currentPhase];
  $CyclePhase::input14 = (int)B[currentCycle][14][currentPhase];
  $CyclePhase::input15 = (int)B[currentCycle][15][currentPhase];
  $CyclePhase::input16 = (int)B[currentCycle][16][currentPhase];
  $CyclePhase::input17 = (int)B[currentCycle][17][currentPhase];
  
  //Right Arrows - 0,3,5,8
  $CyclePhase::input18 = (int)B[currentCycle][18][currentPhase];
  $CyclePhase::input19 = (int)B[currentCycle][19][currentPhase];
  $CyclePhase::input20 = (int)B[currentCycle][20][currentPhase];
  $CyclePhase::input21 = (int)B[currentCycle][21][currentPhase];
    
  Write("Cycle activated: %d, phase %d", currentCycle, currentPhase);
}

void SetRedLights()
{
  $CyclePhase::time = 0;
  $CyclePhase::input0 = 0;
  $CyclePhase::input1 = 0;
  $CyclePhase::input2 = 0;
  $CyclePhase::input3 = 0;
  $CyclePhase::input4 = 0;
  $CyclePhase::input5 = 0;
  $CyclePhase::input6 = 0;
  $CyclePhase::input7 = 0;
  $CyclePhase::input8 = 0;
  $CyclePhase::input9 = 0;
  $CyclePhase::input10 = 0;
  $CyclePhase::input11 = 0;
  $CyclePhase::input12 = 0;
  $CyclePhase::input13 = 0;
  $CyclePhase::input14 = 0;
  $CyclePhase::input15 = 0;
  $CyclePhase::input16 = 0;
  $CyclePhase::input17 = 0;
  
  $CyclePhase::input18 = 0;
  $CyclePhase::input19 = 0;
  $CyclePhase::input20 = 0;
  $CyclePhase::input21 = 0;
}